## config/boards/arm/nice_nano_v2/Kconfig.board
```kconfig
# Copyright (c) 2024
# SPDX-License-Identifier: MIT

config BOARD_NICE_NANO_V2
	bool "nice!nano v2"
	depends on SOC_NRF52840_QIAA
```

## config/boards/arm/nice_nano_v2/config/boards/arm/nice_nano_v2/Kconfig.defconfig
```kconfig
# Copyright (c) 2024
# SPDX-License-Identifier: MIT

if BOARD_NICE_NANO_V2

config BOARD
	default "nice_nano_v2"

config ZMK_KEYBOARD_NAME
	default "nice!nano v2"

if USB_DEVICE_STACK

config USB_NRFX
	default y

endif # USB_DEVICE_STACK

config BT_CTLR
	default BT

config ZMK_BLE
	default y

config ZMK_USB
	default y

config ZMK_BATTERY_VOLTAGE_DIVIDER
	default y

endif # BOARD_NICE_NANO_V2
```

## config/boards/arm/nice_nano_v2/config/boards/arm/nice_nano_v2/nice_nano_v2_defconfig
```kconfig
# Copyright (c) 2024
# SPDX-License-Identifier: MIT

CONFIG_SOC_SERIES_NRF52X=y
CONFIG_SOC_NRF52840_QIAA=y
CONFIG_BOARD_NICE_NANO_V2=y

# Enable MPU
CONFIG_ARM_MPU=y

# Enable hardware stack protection
CONFIG_HW_STACK_PROTECTION=y

# Enable GPIO
CONFIG_GPIO=y

# Enable USB
CONFIG_USB_DEVICE_STACK=y
CONFIG_USB_DEVICE_REMOTE_WAKEUP=y
CONFIG_USB_DEVICE_PRODUCT="nice!nano v2"
CONFIG_USB_DEVICE_VID=0x1209
CONFIG_USB_DEVICE_PID=0x0B6C
CONFIG_USB_CDC_ACM=y

# Enable serial console
CONFIG_SERIAL=y
CONFIG_CONSOLE=y
CONFIG_UART_CONSOLE=y
CONFIG_UART_LINE_CTRL=y

# BLE
CONFIG_BT=y
CONFIG_BT_PERIPHERAL=y
CONFIG_BT_CENTRAL=y
CONFIG_BT_DEVICE_NAME="nice!nano v2"

# ADC for battery monitoring
CONFIG_ADC=y
```

## config/west.yml
```yaml
manifest:
  remotes:
    - name: zmkfirmware
      url-base: https://github.com/HeeTuic
    - name: badjeff
      url-base: https://github.com/badjeff
  projects:
    - name: zmk
      remote: zmkfirmware
      revision: main
      import: app/west.yml
    - name: zmk-pmw3610-driver
      remote: badjeff
      revision: main
  self:
    path: config
```
